## CMakeLists.txt
```
# SPDX-License-Identifier: Apache-2.0

cmake_minimum_required(VERSION 3.13.1)
include($ENV{ZEPHYR_BASE}/cmake/app/boilerplate.cmake NO_POLICY_SCOPE)
project(central)

target_sources(app PRIVATE
  src/main.c
  src/TimeCommands.c
)

zephyr_library_include_directories($ENV{ZEPHYR_BASE}/samples/bluetooth)
```

## prj.conf
```kconfig
#CONFIG_MAIN_STACK_SIZE=512
CONFIG_BT=y
CONFIG_BT_CENTRAL=y
#CONFIG_BT_DEBUG_LOG=y
#CONFIG_BT_SMP=y
#CONFIG_BT_GATT_CLIENT=y
#CONFIG_BT_HCI_RAW=y
#CONFIG_BT_MAX_CONN=20
#CONFIG_BT_TINYCRYPT_ECC=n
#CONFIG_BT_RX_BUF_COUNT=10
#CONFIG_BT_RX_BUF_LEN=255
```

## src/main.c
```c
/* main.c - Application main entry point */

/*
 * Copyright (c) 2015-2016 Intel Corporation
 *
 * SPDX-License-Identifier: Apache-2.0
 */

#include <zephyr/types.h>
#include <stdio.h>
#include <stddef.h>
#include <errno.h>
#include <time.h>
#include <zephyr.h>
#include <sys/printk.h>

#include <bluetooth/bluetooth.h>
#include <bluetooth/hci_raw.h>
#include <bluetooth/hci.h>
#include <bluetooth/conn.h>
#include <bluetooth/uuid.h>
#include <bluetooth/gatt.h>
#include <sys/byteorder.h>
#include <bluetooth/buf.h>

#include <settings/settings.h>
#include <device.h>
#include <init.h>
#include <drivers/uart.h>
#include <net/buf.h>

#include "data_protocol.h"

static struct bt_conn *conn_mine;


#define BSM_MAX_MSG_LEN    200

static u8_t rxmsg[BSM_MAX_MSG_LEN];


static u8_t txmsg[BSM_MAX_MSG_LEN];

static K_THREAD_STACK_DEFINE(bt_tx_thread_stack, CONFIG_BT_HCI_TX_STACK_SIZE);

static struct k_thread bt_tx_thread_data;

static void bt_tx_thread(void *p1, void *p2, void *p3)
{
	struct net_buf *buf = NULL;
	int ret;
        int len;
        static int command = 0;

	ARG_UNUSED(p1);
	ARG_UNUSED(p2);
	ARG_UNUSED(p3);

	(void)memset(txmsg, 0xFF, BSM_MAX_MSG_LEN);

	while (1) {
            if(command == 0)
            {
              FormSetTimeCommand(buf->data,&len);
              command++;
            }
            else
            {
              FormReportStatusCommand(buf->data,&len);
              command = 0;
            }
            buf->len = len;
            //GOTO BSM PROCESSING
            /* Receiving data from the BSM */
            ret = bt_send(buf);
	    if (ret) {
		printk("Unable to send (ret %d)", ret);
		net_buf_unref(buf);
	     }

	     //STACK_ANALYZE("tx_stack", bt_tx_thread_stack);

	     /* Make sure other threads get a chance to run */
	     k_yield();
	}
}

// Custom Service Variables 
static struct bt_uuid_128 vnd_uuid = BT_UUID_INIT_128(
	0xf0, 0xde, 0xbc, 0x9a, 0x78, 0x56, 0x34, 0x12,
	0x78, 0x56, 0x34, 0x12, 0x78, 0x56, 0x34, 0x12);

static struct bt_uuid_128 vnd_enc_uuid = BT_UUID_INIT_128(
	0xf1, 0xde, 0xbc, 0x9a, 0x78, 0x56, 0x34, 0x12,
	0x78, 0x56, 0x34, 0x12, 0x78, 0x56, 0x34, 0x12);

static struct bt_uuid_128 vnd_auth_uuid = BT_UUID_INIT_128(
	0xf2, 0xde, 0xbc, 0x9a, 0x78, 0x56, 0x34, 0x12,
	0x78, 0x56, 0x34, 0x12, 0x78, 0x56, 0x34, 0x12);

static u8_t vnd_value[] = { 'V', 'e', 'n', 'd', 'o', 'r' };
static u8_t simulate_vnd;
static u8_t indicating;
static struct bt_gatt_indicate_params ind_params;

static ssize_t read_vnd(struct bt_conn *conn, const struct bt_gatt_attr *attr,
			void *buf, u16_t len, u16_t offset)
{
	const char *value = attr->user_data;

	return bt_gatt_attr_read(conn, attr, buf, len, offset, value,
				 strlen(value));
}


static ssize_t write_vnd(struct bt_conn *conn, const struct bt_gatt_attr *attr,
			 const void *buf, u16_t len, u16_t offset,
			 u8_t flags)
{
	u8_t *value = attr->user_data;

	if (offset + len > sizeof(vnd_value)) {
		return BT_GATT_ERR(BT_ATT_ERR_INVALID_OFFSET);
	}

	memcpy(value + offset, buf, len);

	return len;
}

static void vnd_ccc_cfg_changed(const struct bt_gatt_attr *attr, u16_t value)
{
	simulate_vnd = (value == BT_GATT_CCC_INDICATE) ? 1 : 0;
}




#define MAX_DATA 74
static u8_t vnd_long_value[] = {
		  'V', 'e', 'n', 'd', 'o', 'r', ' ', 'd', 'a', 't', 'a', '1',
		  'V', 'e', 'n', 'd', 'o', 'r', ' ', 'd', 'a', 't', 'a', '2',
		  'V', 'e', 'n', 'd', 'o', 'r', ' ', 'd', 'a', 't', 'a', '3',
		  'V', 'e', 'n', 'd', 'o', 'r', ' ', 'd', 'a', 't', 'a', '4',
		  'V', 'e', 'n', 'd', 'o', 'r', ' ', 'd', 'a', 't', 'a', '5',
		  'V', 'e', 'n', 'd', 'o', 'r', ' ', 'd', 'a', 't', 'a', '6',
		  '.', ' ' };


static ssize_t read_long_vnd(struct bt_conn *conn,
			     const struct bt_gatt_attr *attr, void *buf,
			     u16_t len, u16_t offset)
{
	const char *value = attr->user_data;

	return bt_gatt_attr_read(conn, attr, buf, len, offset, value,
				 sizeof(vnd_long_value));
}


static ssize_t write_long_vnd(struct bt_conn *conn,
			      const struct bt_gatt_attr *attr, const void *buf,
			      u16_t len, u16_t offset, u8_t flags)
{
	u8_t *value = attr->user_data;

	if (flags & BT_GATT_WRITE_FLAG_PREPARE) {
		return 0;
	}

	if (offset + len > sizeof(vnd_long_value)) {
		return BT_GATT_ERR(BT_ATT_ERR_INVALID_OFFSET);
	}

	memcpy(value + offset, buf, len);

	return len;
}

static const struct bt_uuid_128 vnd_long_uuid = BT_UUID_INIT_128(
	0xf3, 0xde, 0xbc, 0x9a, 0x78, 0x56, 0x34, 0x12,
	0x78, 0x56, 0x34, 0x12, 0x78, 0x56, 0x34, 0x12);

static struct bt_gatt_cep vnd_long_cep = {
	.properties = BT_GATT_CEP_RELIABLE_WRITE,
};

static int signed_value;

static ssize_t read_signed(struct bt_conn *conn, const struct bt_gatt_attr *attr,
			   void *buf, u16_t len, u16_t offset)
{
	const char *value = attr->user_data;

	return bt_gatt_attr_read(conn, attr, buf, len, offset, value,
				 sizeof(signed_value));
}


static ssize_t write_signed(struct bt_conn *conn, const struct bt_gatt_attr *attr,
			    const void *buf, u16_t len, u16_t offset,
			    u8_t flags)
{
	u8_t *value = attr->user_data;

	if (offset + len > sizeof(signed_value)) {
		return BT_GATT_ERR(BT_ATT_ERR_INVALID_OFFSET);
	}

	memcpy(value + offset, buf, len);

	return len;
}

static const struct bt_uuid_128 vnd_signed_uuid = BT_UUID_INIT_128(
	0xf3, 0xde, 0xbc, 0x9a, 0x78, 0x56, 0x34, 0x13,
	0x78, 0x56, 0x34, 0x12, 0x78, 0x56, 0x34, 0x13);

static const struct bt_uuid_128 vnd_write_cmd_uuid = BT_UUID_INIT_128(
	0xf4, 0xde, 0xbc, 0x9a, 0x78, 0x56, 0x34, 0x12,
	0x78, 0x56, 0x34, 0x12, 0x78, 0x56, 0x34, 0x12);

static ssize_t write_without_rsp_vnd(struct bt_conn *conn,
				     const struct bt_gatt_attr *attr,
				     const void *buf, u16_t len, u16_t offset,
				     u8_t flags)
{
	u8_t *value = attr->user_data;

	// Write request received. Reject it since this char only accepts
	// Write Commands.
	
	if (!(flags & BT_GATT_WRITE_FLAG_CMD)) {
		return BT_GATT_ERR(BT_ATT_ERR_WRITE_REQ_REJECTED);
	}

	if (offset + len > sizeof(vnd_value)) {
		return BT_GATT_ERR(BT_ATT_ERR_INVALID_OFFSET);
	}

	memcpy(value + offset, buf, len);

	return len;
}

// Vendor Primary Service Declaration 
BT_GATT_SERVICE_DEFINE(vnd_svc,
	BT_GATT_PRIMARY_SERVICE(&vnd_uuid),
	BT_GATT_CHARACTERISTIC(&vnd_enc_uuid.uuid,
			       BT_GATT_CHRC_READ | BT_GATT_CHRC_WRITE |
			       BT_GATT_CHRC_INDICATE,
			       BT_GATT_PERM_READ_ENCRYPT |
			       BT_GATT_PERM_WRITE_ENCRYPT,
			       read_vnd, write_vnd, vnd_value),
	BT_GATT_CCC(vnd_ccc_cfg_changed),
	BT_GATT_CHARACTERISTIC(&vnd_auth_uuid.uuid,
			       BT_GATT_CHRC_READ | BT_GATT_CHRC_WRITE,
			       BT_GATT_PERM_READ_AUTHEN |
			       BT_GATT_PERM_WRITE_AUTHEN,
			       read_vnd, write_vnd, vnd_value),
	BT_GATT_CHARACTERISTIC(&vnd_long_uuid.uuid, BT_GATT_CHRC_READ |
			       BT_GATT_CHRC_WRITE | BT_GATT_CHRC_EXT_PROP,
			       BT_GATT_PERM_READ | BT_GATT_PERM_WRITE |
			       BT_GATT_PERM_PREPARE_WRITE,
			       read_long_vnd, write_long_vnd, &vnd_long_value),
	BT_GATT_CEP(&vnd_long_cep),
	BT_GATT_CHARACTERISTIC(&vnd_signed_uuid.uuid, BT_GATT_CHRC_READ |
			       BT_GATT_CHRC_WRITE | BT_GATT_CHRC_AUTH,
			       BT_GATT_PERM_READ | BT_GATT_PERM_WRITE,
			       read_signed, write_signed, &signed_value),
	BT_GATT_CHARACTERISTIC(&vnd_write_cmd_uuid.uuid,
			       BT_GATT_CHRC_WRITE_WITHOUT_RESP,
			       BT_GATT_PERM_WRITE, NULL,
			       write_without_rsp_vnd, &vnd_value),
);

static const struct bt_data ad[] = {
	BT_DATA_BYTES(BT_DATA_FLAGS, (BT_LE_AD_GENERAL | BT_LE_AD_NO_BREDR)),
	BT_DATA_BYTES(BT_DATA_UUID16_ALL,
		      0x0d, 0x18, 0x0f, 0x18, 0x05, 0x18),
	BT_DATA_BYTES(BT_DATA_UUID128_ALL,
		      0xf0, 0xde, 0xbc, 0x9a, 0x78, 0x56, 0x34, 0x12,
		      0x78, 0x56, 0x34, 0x12, 0x78, 0x56, 0x34, 0x12),
};

static void auth_passkey_display(struct bt_conn *conn, unsigned int passkey)
{
	char addr[BT_ADDR_LE_STR_LEN];

	bt_addr_le_to_str(bt_conn_get_dst(conn), addr, sizeof(addr));

	printk("Passkey for %s: %06u\n", addr, passkey);
}

static void auth_cancel(struct bt_conn *conn)
{
	char addr[BT_ADDR_LE_STR_LEN];

	bt_addr_le_to_str(bt_conn_get_dst(conn), addr, sizeof(addr));

	printk("Pairing cancelled: %s\n", addr);
}

static struct bt_conn_auth_cb auth_cb_display = {
	.passkey_display = auth_passkey_display,
	.passkey_entry = NULL,
	.cancel = auth_cancel,
};


static void device_found(const bt_addr_le_t *addr, s8_t rssi, u8_t type,
			 struct net_buf_simple *ad)
{
	char addr_str[BT_ADDR_LE_STR_LEN];

	if (conn_mine) {
		return;
	}

	/* We're only interested in connectable events */
	if (type != BT_LE_ADV_IND && type != BT_LE_ADV_DIRECT_IND) {
		return;
	}

	bt_addr_le_to_str(addr, addr_str, sizeof(addr_str));
	printk("Device found: %s (RSSI %d)\n", addr_str, rssi);

	/* connect only to devices in close proximity */
	if (rssi < -70) {
		return;
	}

	if (bt_le_scan_stop()) {
		return;
	}

	conn_mine = bt_conn_create_le(addr, BT_LE_CONN_PARAM_DEFAULT);
}
static void indicate_cb(struct bt_conn *conn, const struct bt_gatt_attr *attr,
			u8_t err)
{
	printk("Indication %s\n", err != 0U ? "fail" : "success");
        indicating = 0U;
 }

static void connected(struct bt_conn *conn, u8_t err)
{
	char addr[BT_ADDR_LE_STR_LEN];

	bt_addr_le_to_str(bt_conn_get_dst(conn), addr, sizeof(addr));

	if (err) {
		printk("Failed to connect to %s (%u)\n", addr, err);
		return;
	}

	if (conn != conn_mine) {
		return;
	}

	printk("Connected: %s\n", addr);
    
        indicate_cb(conn, &vnd_svc, err);

	//bt_conn_disconnect(conn, BT_HCI_ERR_REMOTE_USER_TERM_CONN);
}

static void disconnected(struct bt_conn *conn, u8_t reason)
{
	char addr[BT_ADDR_LE_STR_LEN];
	int err;

	if (conn != conn_mine) {
		return;
	}

	bt_addr_le_to_str(bt_conn_get_dst(conn), addr, sizeof(addr));

	printk("Disconnected: %s (reason 0x%02x)\n", addr, reason);

	bt_conn_unref(conn_mine);
	conn_mine = NULL;

	/* This demo doesn't require active scan */
	err = bt_le_scan_start(BT_LE_SCAN_PASSIVE, device_found);
	if (err) {
		printk("Scanning failed to start (err %d)\n", err);
	}
}

static struct bt_conn_cb conn_callbacks = {
		.connected = connected,
		.disconnected = disconnected,
};

void main(void)
{
        static K_FIFO_DEFINE(rx_queue);
	struct net_buf *buf;
	k_tid_t tx_id;

	int err;

	err = bt_enable(NULL);

	if (err) {
		printk("Bluetooth init failed (err %d)\n", err);
		return;
	}

	printk("Bluetooth initialized\n");

	bt_conn_cb_register(&conn_callbacks);

	err = bt_le_scan_start(BT_LE_SCAN_ACTIVE, device_found);
	if (err) {
		printk("Scanning failed to start (err %d)\n", err);
		return;
	}

	printk("Scanning successfully started\n");

	printk("Start");

	/* Spawn the TX thread, which feeds cmds and data to the controller */
/*
	tx_id = k_thread_create(&bt_tx_thread_data, bt_tx_thread_stack,
				K_THREAD_STACK_SIZEOF(bt_tx_thread_stack),
				bt_tx_thread, NULL, NULL, NULL, K_PRIO_COOP(7),
				0, K_NO_WAIT);

*/   
     while(1) {
     		k_sleep(MSEC_PER_SEC);

                buf = net_buf_get(&rx_queue, K_FOREVER);
                if(buf->len > 0)
                   CheckResponses(buf->data, buf->len);
     }
}
```

## src/TimeCommands.c
```c
#include <time.h>
#include <stdio.h>

#include "data_protocol.h"


#define  MAX_DATA_PROTOCOL_MESSAGE_SIZE    200
#define  LITTLE_ENDIAN                     true //We assuming that this software is running on ARM processor 
#define  DATA_BUS_WIDENESS                 32

static unsigned char incoming_message[MAX_DATA_PROTOCOL_MESSAGE_SIZE];
static int incoming_message_length;
static unsigned char outcoming_message[MAX_DATA_PROTOCOL_MESSAGE_SIZE];
static int outcoming_message_length;
MessageTimestamp *GetInsideTimeinTimestamp(void);
void convert_big_endian_to_little_endian_and_back(unsigned char *src, unsigned char *dest, short int length);
long int calculateCRC32(unsigned char *data);

void FormSetTimeCommand(u8_t *data, u16_t *len)
{
	SMessageHeader *request_hdr_ptr = (SMessageHeader *)&incoming_message[0];
	MsgIntegrity_d *crc_ptr = (MsgIntegrity_d *)(&incoming_message[0] + sizeof(OP_code_command) + sizeof(SMessageHeader) + sizeof(MessageTimestamp) + sizeof(SynchTime));
        MessageTimestamp *tstamp = (MessageTimestamp *)(&incoming_message[0] + sizeof(SMessageHeader) + sizeof(OP_code_command));
	SynchTime *stime =(SynchTime *)(&incoming_message[0] + sizeof(SMessageHeader) + sizeof(MessageTimestamp) + sizeof(OP_code_command));
        OP_code_command *op =(OP_code_command *)(&incoming_message[0] + sizeof(SMessageHeader)); 
    //Forming message header
    request_hdr_ptr->st = SensorController;
    request_hdr_ptr->mt = SetTime;
    request_hdr_ptr->ml = sizeof(MessageTimestamp) + sizeof(SynchTime) + sizeof(MsgIntegrity);
    memcpy(&request_hdr_ptr->sa.sa_data[0],"EC6F49972861",sizeof(SourceAddress));
    memcpy(&request_hdr_ptr->da.da_data[0],"EC6F49972861",sizeof(SourceAddress));
    request_hdr_ptr->icd_rev = 6;
    memcpy(&request_hdr_ptr->msga,"1111",sizeof(MSGAscension));
    request_hdr_ptr->rp = 1;
    *op = SetTime;
    //Forming timestamp
	memcpy((void *)tstamp,(void *)GetInsideTimeinTimestamp(),sizeof(MessageTimestamp));
	//Forming SynchTime
	memcpy((void *)stime,(void *)GetInsideTimeinTimestamp(),sizeof(SynchTime));
	//Forming CRC
	*crc_ptr = calculateCRC32(data);
	outcoming_message_length = sizeof(SMessageHeader) + sizeof(MessageTimestamp) + sizeof(SynchTime) + sizeof(MsgIntegrity);
#ifdef LITTLE_ENDIAN
    convert_big_endian_to_little_endian_and_back(&incoming_message[0],&outcoming_message[0], outcoming_message_length);
	memcpy(data,&outcoming_message[0],outcoming_message_length);
#else
	memcpy(data,&incoming_message[0],outcoming_message_length);
#endif
    *len = sizeof(SMessageHeader) + sizeof(MessageTimestamp) + sizeof(SynchTime) + sizeof(MsgIntegrity);
}

void FormReportStatusCommand(u8_t *data, u16_t *len)
{
	SMessageHeader *request_hdr_ptr = (SMessageHeader *)&incoming_message[0];
	MsgIntegrity_d *crc_ptr = (MsgIntegrity_d *)(&incoming_message[0] + sizeof(SMessageHeader) + sizeof(OP_code_command) + sizeof(MessageTimestamp));
    MessageTimestamp *tstamp = (MessageTimestamp *)(&incoming_message[0] + sizeof(SMessageHeader) + sizeof(OP_code_command));
        OP_code_command *op =(OP_code_command *)(&incoming_message[0] + sizeof(SMessageHeader));
    //Forming message header
    request_hdr_ptr->st = SensorController;
    request_hdr_ptr->mt = ReportStatus;
    request_hdr_ptr->ml = sizeof(MessageTimestamp) + sizeof(MsgIntegrity);
    memcpy(&request_hdr_ptr->sa.sa_data[0],"EC6F49972861",sizeof(SourceAddress));
    memcpy(&request_hdr_ptr->da.da_data[0],"EC6F49972861",sizeof(SourceAddress));
    request_hdr_ptr->icd_rev = 6;
    memcpy(&request_hdr_ptr->msga,"1112",sizeof(MSGAscension));
    request_hdr_ptr->rp = 1;
    *op = ReportStatus;
    //Forming timestamp
	memcpy((void *)tstamp,(void *)GetInsideTimeinTimestamp(),sizeof(MessageTimestamp));
	//Forming CRC
	*crc_ptr = calculateCRC32(data);
	outcoming_message_length = sizeof(SMessageHeader) + sizeof(MessageTimestamp) + sizeof(MsgIntegrity);
#ifdef LITTLE_ENDIAN
	convert_big_endian_to_little_endian_and_back(&incoming_message[0],&outcoming_message[0], outcoming_message_length);
	memcpy(data,&outcoming_message[0],outcoming_message_length);
#else
	memcpy(data,&incoming_message[0],outcoming_message_length);
#endif
    *len = sizeof(SMessageHeader) + sizeof(MessageTimestamp) + sizeof(MsgIntegrity);
}

void CheckResponses(u8_t *data, u16_t len)
{
    SMessageHeader *response_hdr_ptr = (SMessageHeader *)&incoming_message[0];
	ACK *response_ack_ptr = (ACK *)(&incoming_message[0] +sizeof(SMessageHeader));
    MsgSolicitedPaylodResponse *response_msg_ptr = (MsgSolicitedPaylodResponse *)(&incoming_message[0] +sizeof(SMessageHeader));
    MessageTimestamp *response_time_ptr = (MessageTimestamp *)&incoming_message[sizeof(SMessageHeader)];
	MessageTimestamp currTime;
	char text_message[100];
	
#ifdef LITTLE_ENDIAN
        incoming_message_length = len;
	convert_big_endian_to_little_endian_and_back(data,&incoming_message[0], incoming_message_length);
	memcpy(data,&outcoming_message[0],outcoming_message_length);
#else
        incoming_message_length = len;
	memcpy(&incoming_message[0],data,len);
#endif

	switch(response_hdr_ptr->mt)
	{
		case ACKMessage:

            sprintf(&text_message[0],"Acknowledgement %c\n", response_ack_ptr->a_d.aw);
            printk(&text_message[0],strlen(&text_message[0]));			
		break;
		case SolictedStatusMessage:
		     sprintf(&text_message[0],"Time Set %d, Time Awake Hours %d\n",response_msg_ptr->ss.ssb.Time_Set_Status,response_msg_ptr->ss.at.at_d);
		     printk(&text_message[0],strlen(&text_message[0]));
		break;
		default: //Hurtbeat
		memcpy((void *)&currTime,(void *)&(response_time_ptr->m_d),sizeof(MessageTimestamp));
		sprintf(&text_message[0],"\r\nTime on BSM Year %d Month %d Day %d Hour %d Minutes %d Seconds %d\n",
		currTime.m_d.year + 30, //Linux start epox 1970, AKUA 2000
		currTime.m_d.month + 1,
		currTime.m_d.day + 1,
		currTime.m_d.hour,
		currTime.m_d.minute,
	    currTime.m_d.seconds);
		printk(&text_message[0],strlen(&text_message[0]));
		break;
	}
}
MessageTimestamp *GetInsideTimeinTimestamp(void)
{
	struct tm ts;
	static MessageTimestamp currTime;	
	
	memcpy(&ts,gmtime(0),sizeof(struct tm));
	
	currTime.m_d.seconds = ts.tm_sec;
    currTime.m_d.minute = ts.tm_min;
    currTime.m_d.hour = ts.tm_hour;
    currTime.m_d.day = ts.tm_mday;
    currTime.m_d.month = ts.tm_mon;
	currTime.m_d.year = ts.tm_year - 30 ; //Linux start epox 1970, AKUA 2000
	
	return &currTime; 
}

void convert_big_endian_to_little_endian_and_back(unsigned char *src, unsigned char *dest, short int length)
{
	short int chunks, index, piece;
	
	chunks = (int)(length/DATA_BUS_WIDENESS - 0.5);
	chunks++;
	for(piece = 0; piece < chunks; piece++) {
	    for(index = 0; index < DATA_BUS_WIDENESS; index++) {
	        *dest++ = *(src + DATA_BUS_WIDENESS - 1 - index)  ;
		}
	    dest += DATA_BUS_WIDENESS;
		src  += DATA_BUS_WIDENESS;
	}
}
long int calculateCRC32(unsigned char *data)
{
    	const uint8_t *p = data;
		SMessageHeader *ps = (SMessageHeader *)data; 
		uint32_t size = (uint32_t)sizeof(SMessageHeader) + (uint32_t)ps->ml - (uint32_t)sizeof(MsgIntegrity); 
 		uint32_t crc;
 
 		crc = ~0U;
 		while (size--)
 			crc = ((crc ^ *p++) & 0xFF) ^ (crc >> 8);
 		return (long int)(crc ^ ~0U);
}
```

## src/data_protocol.h
```c
/*This data protocol reflects "Secure Hybrid Composite Intermodal Container Project"
 * 
 */
#include <zephyr/types.h>
/*SHCIC Message Header*/
typedef unsigned char SourceDeviceType;
typedef unsigned char MSGLength;
typedef unsigned char MSGType;
typedef union {
	unsigned char sa[6];
	unsigned char sa_data[6];  
} SourceAddress;
typedef union {
	unsigned char da[6];
	unsigned char da_data[6];
} DestinationAddress;
typedef unsigned char ICDRev;
typedef union {
	unsigned char msga[4];
	unsigned char msga_data[4];
}  MSGAscension;
typedef unsigned char RoutingPriority;

typedef struct {
	SourceDeviceType st;
	MSGType mt;
	MSGLength ml;
	SourceAddress sa;
	DestinationAddress da;
	ICDRev icd_rev;
	MSGAscension msga;
	RoutingPriority rp;
} SMessageHeader;

/*3.6.1.2 Message Device Type Codes*/ 
typedef enum {
	BSM=0x80,
	SensorController=0x81,
	C2Server=0x88,
	KeyMgmtServer=0x89
} DeviceType;

/*3.6.1.3 Message Type Codes*/
typedef enum {
	SolictedStatusMessage=0x80,
	DeviceEventLogRecord=0x81,
	UnsolictedStatusMessage=0x82,
	ACKMessage=0x83,
	SecurityDeviceMaintMessage_0=0x90,
	SecurityDeviceMaintMessage_1=0x91,
	SecurityDeviceMaintMessage_2=0x92,
	SecurityDeviceMaintMessage_3=0x93,
	SecurityDeviceMaintMessage_4=0x94,
	SecurityDeviceMaintMessage_5=0x95,
	SecurityDeviceMaintMessage_6=0x96,
	SecurityDeviceMaintMessage_7=0x97,
	SecurityDeviceMaintMessage_8=0x98,
	SecurityDeviceMaintMessage_9=0x99,
	SecurityDeviceMaintMessage_A=0x9A,
	SecurityDeviceMaintMessage_B=0x9B,
	SecurityDeviceMaintMessage_C=0x9C,
	SecurityDeviceMaintMessage_D=0x9D,
	SecurityDeviceMaintMessage_E=0x9E,
	SecurityDeviceMaintMessage_F=0x9F,
	DeviceCommand=0xC1,
	KeyMgmtRekey_0=0xE0,
	KeyMgmtRekey_1=0xE1,
	KeyMgmtRekey_2=0xE2,
	KeyMgmtRekey_3=0xE3,
	KeyMgmtRekey_4=0xE4,
	KeyMgmtRekey_5=0xE5,
	KeyMgmtRekey_6=0xE6,
	KeyMgmtRekey_7=0xE7,
	KeyMgmtRekey_8=0xE8,
	KeyMgmtRekey_9=0xE9,
} MessageTypeCode;

/* 3.6.2.1 Device Command Message */	
typedef union {
	unsigned char data[25];
	SMessageHeader smh;
} UniversalMSGHeader;
typedef enum {
	ReportStatus=0x1,
	RunDiagnostics=0x2,
	SetTime=0x3,
	ARM=0x4,
	PairCommand=0x5,
	UnPairCommand=0x6,
	DISARM=0x80,
	SendAllEventLog=0xA4,
	EraseEventLog=0xA5,
	ConfigureSensor=0x8
} OP_Code;
typedef unsigned char OP_code_command;
typedef struct {
	unsigned char month;
	unsigned char day;
	uint16_t      year; //Year starting 2000
	unsigned char hour;
	unsigned char minute;
	unsigned char seconds;
	unsigned char hundr_of_seconds;
}   MessageTimestamp_d;
typedef union {
	unsigned char data[8];
	MessageTimestamp_d m_d;
} MessageTimestamp;
typedef unsigned char SynchTime_d[8];
typedef union {
	unsigned char data[8];
	SynchTime_d  s_d;
} SynchTime;
typedef unsigned char SensorToEnable_d[8];
typedef union {
	unsigned char data[8];
	SensorToEnable_d s_d;
} SensorToEnable;
typedef unsigned char unconditional_par;
typedef enum {
	unconditional_yes=0xFF
} unconditional_value;
typedef unsigned char CSD_SD_MAC_d[8];
typedef union {
	unsigned char data[8];
	CSD_SD_MAC_d csd_d;
} CSD_SD_MAC;
typedef unsigned char BSM_Sensor_MAC_d[8];
typedef union {
	unsigned char data[8];
	BSM_Sensor_MAC_d b_d;
} BSM_Sensor_MAC;
typedef unsigned char BSM_Sensor_Type;
typedef unsigned char BSM_Sensor_UID_d[8];
typedef union {
	unsigned char data[8];
	BSM_Sensor_UID_d b_d;
} BSM_Sensor_UID;
typedef unsigned char SensorToDisable_d[8];
typedef union {
	unsigned char data[8];
	SensorToDisable_d s_d;
} SensorToDisable;
typedef unsigned char ConfigurationParam;
typedef uint32_t MsgIntegrity_d;
typedef union {
	unsigned char data[8];
	MsgIntegrity_d  m_d;
} MsgIntegrity;
typedef struct {
	MessageTimestamp mt;
} ReportStatusPayload;
typedef struct {
	MessageTimestamp mt;
} RunDiagnosticsPayload;
typedef struct {
	MessageTimestamp mt;
	SynchTime st;
} SetTimePayload;
typedef struct {
	MessageTimestamp mt;
	SensorToEnable se;
} ARMPayload;
typedef struct {
	MessageTimestamp mt;
	CSD_SD_MAC csd;
	BSM_Sensor_MAC bsmm;
	BSM_Sensor_Type bsmt;
	BSM_Sensor_UID bsmu;
} PairCommandPayload;
typedef struct {
	MessageTimestamp mt;
} UnPairCommandPayload;
typedef struct {
	MessageTimestamp mt; 
	SensorToDisable sd;
} DISARMPayload;
typedef struct {
	MessageTimestamp mt;
} SendAllEventLogPayload;
typedef struct {
	MessageTimestamp mt;
} EraseEventLogPayload;
typedef struct {
	MessageTimestamp mt;
	ConfigurationParam cp;
} ConfigureSensorPayload;
typedef union {
	unsigned char data[94];
	ReportStatusPayload rsp;
	RunDiagnosticsPayload rdp;
	SetTimePayload stp;
	ARMPayload armp;
	PairCommandPayload pcp;
	UnPairCommandPayload upcp;
	DISARMPayload darmp;
	SendAllEventLogPayload sael;
	EraseEventLogPayload eelp;
	ConfigureSensorPayload csp;
} MSGPayload;

typedef struct {
	UniversalMSGHeader umh;
	MSGPayload mp;
	MsgIntegrity mi;
}  DeviceCommandMessage;

typedef struct {
	unsigned Diag_Status : 1;
	unsigned Pwr_Status : 1;
	unsigned Pairing_Status : 1;
	unsigned Arming_Status : 1;
	unsigned Time_Set_Status : 1;
	unsigned unused : 3;
} SolicitedStatusBits;

typedef unsigned char Alarm_Status;

typedef uint8_t Awake_Time_d;

typedef union {
	unsigned char data[2];
	Awake_Time_d at_d;
} Awake_Time;
 
typedef uint16_t Rekey_Counter_d;

typedef union {
	unsigned char data[4];
	Rekey_Counter_d rc_d;
} Rekey_Counter;

typedef uint16_t ACK_Ascension_d;

typedef union {
	unsigned char data[4];
	ACK_Ascension_d aa_d;
} ACK_Ascension;
 
/* 3.6.2.2.1 Solicited Status Message */
typedef struct {
	SolicitedStatusBits ssb;
	Alarm_Status as;
	Awake_Time at;
	Rekey_Counter rc;
	ACK_Ascension aa;
} Status_Summary;

typedef unsigned char Panel_Alarm_Data_d[7];

typedef union {
	unsigned char data[7];
	Panel_Alarm_Data_d pad_d;
} Panel_Alarm_Data;

typedef unsigned char Door_State;

typedef unsigned char Pwr_Level;

typedef unsigned char Reserved1[12];

typedef struct {
	Panel_Alarm_Data pad;
	Door_State ds;
	Pwr_Level pl;
	Reserved1 r1;
} BDS_Status_Details;

typedef struct {
	Reserved1 r1;
} Alarm_Details;

typedef union {
	Status_Summary ss;
	BDS_Status_Details bsd;
	Alarm_Details ad;
	unsigned char data[94];
} MsgSolicitedPaylodResponse;

/* 3.6.2.4.1 Acknoledgement message */
typedef uint16_t ACK_Asc;
typedef unsigned char ACK_WQ;
typedef struct {
	ACK_Asc aa;
	ACK_WQ aw;
} ACK_d;
typedef union {
	unsigned char data[5];
	ACK_d a_d;
} ACK;

/* 3.6.2.5.1 Device Event Log Message*/

typedef unsigned char AscensionEventLogRequest;
typedef unsigned char EventType;
typedef uint32_t EventTime_d;
typedef union {
	unsigned char data[8];
	EventTime_d et_d;
} EventTime;
typedef unsigned char LastRequestRecord;

typedef unsigned char Panel_Alarm_Data_Dflt_d[80];
typedef union {
	unsigned char data[80];
	Panel_Alarm_Data_Dflt_d padd_d;
} Panel_Alarm_Data_Dflt;

typedef struct {
	AscensionEventLogRequest aelr;
	EventType etp;
	EventTime et;
	LastRequestRecord lrr;
	Panel_Alarm_Data_Dflt padd;
} MsgPayloadEventLogResponse;


typedef union {
	MsgSolicitedPaylodResponse mspr;
	ACK ack;
	MsgPayloadEventLogResponse mpelr;
} MsgPaylodResponse;
void FormSetTimeCommand(u8_t *data, u16_t *len);
void FormReportStatusCommand(u8_t *data, u16_t *len);
void CheckResponses(u8_t *data, u16_t len);
```
