## CMakeLists.txt
```
# SPDX-License-Identifier: Apache-2.0

cmake_minimum_required(VERSION 3.13.1)
include($ENV{ZEPHYR_BASE}/cmake/app/boilerplate.cmake NO_POLICY_SCOPE)
project(peripheral)

target_sources(app PRIVATE
  src/main.c
  src/cts.c
  src/ReceiveProcessData.c
)
```

## prj.conf
```kconfig
# Incresed stack due to settings API usage
CONFIG_SYSTEM_WORKQUEUE_STACK_SIZE=2048

CONFIG_BT=y
CONFIG_BT_DEBUG_LOG=y
CONFIG_BT_SMP=y
CONFIG_BT_SIGNING=y
CONFIG_BT_PERIPHERAL=y
CONFIG_BT_CENTRAL=n
CONFIG_BT_GATT_DIS=y
CONFIG_BT_ATT_PREPARE_COUNT=2
CONFIG_BT_PRIVACY=y
CONFIG_BT_DEVICE_NAME="Zephyr Peripheral Sample Long Name"
CONFIG_BT_DEVICE_APPEARANCE=833
CONFIG_BT_DEVICE_NAME_DYNAMIC=y
CONFIG_BT_DEVICE_NAME_MAX=65

CONFIG_BT_SETTINGS=y
CONFIG_FLASH=y
CONFIG_FLASH_PAGE_LAYOUT=y
CONFIG_FLASH_MAP=y
CONFIG_FCB=y
CONFIG_SETTINGS=y
CONFIG_SETTINGS_FCB=y
```

## src/main.c
```c
/* main.c - Application main entry point */

/*
 * Copyright (c) 2015-2016 Intel Corporation
 *
 * SPDX-License-Identifier: Apache-2.0
 */
#include <zephyr/types.h>
#include <stdio.h>
#include <stddef.h>
#include <string.h>
#include <errno.h>
#include <time.h>
#include <zephyr.h>
#include <sys/printk.h>

#include <settings/settings.h>

#include <bluetooth/bluetooth.h>
#include <bluetooth/conn.h>
#include <bluetooth/uuid.h>
#include <bluetooth/gatt.h>
#include <bluetooth/buf.h>

#include <sys/byteorder.h>


#include <device.h>
#include <init.h>
#include <drivers/uart.h>
#include <net/buf.h>

#include "cts.h"
#include "data_protocol.h"

#define BSM_MAX_MSG_LEN    200


static u8_t txmsg[BSM_MAX_MSG_LEN];

static K_THREAD_STACK_DEFINE(bt_tx_thread_stack, CONFIG_BT_HCI_TX_STACK_SIZE);

static struct k_thread bt_tx_thread_data;

extern int ready_to_process_flag;
extern int ready_to_send_flag;


static void bt_tx_thread(void *p1, void *p2, void *p3)
{
	struct net_buf *buf = NULL;
	int ret;
        u16_t len;

	ARG_UNUSED(p1);
	ARG_UNUSED(p2);
	ARG_UNUSED(p3);

	(void)memset(txmsg, 0xFF, BSM_MAX_MSG_LEN);

	while (1) {

            //GOTO BSM PROCESSING
            /* Receiving data from the BSM */
            if(ready_to_send_flag == 1)
            {
               ready_to_send_flag = 0;

               data_to_send(buf->data,&len);
               buf->len  = len;
               ret = bt_send(buf);
	       if (ret) {
		  printk("Unable to send (ret %d)", ret);
		  net_buf_unref(buf);
	       }
            }

	     //STACK_ANALYZE("tx_stack", bt_tx_thread_stack);

	     /* Make sure other threads get a chance to run */
	     k_yield();
	}
}


/* Custom Service Variables */
struct bt_uuid_128 vnd_uuid = BT_UUID_INIT_128(
	0xf0, 0xde, 0xbc, 0x9a, 0x78, 0x56, 0x34, 0x12,
	0x78, 0x56, 0x34, 0x12, 0x78, 0x56, 0x34, 0x12);

struct bt_uuid_128 vnd_enc_uuid = BT_UUID_INIT_128(
	0xf1, 0xde, 0xbc, 0x9a, 0x78, 0x56, 0x34, 0x12,
	0x78, 0x56, 0x34, 0x12, 0x78, 0x56, 0x34, 0x12);

struct bt_uuid_128 vnd_auth_uuid = BT_UUID_INIT_128(
	0xf2, 0xde, 0xbc, 0x9a, 0x78, 0x56, 0x34, 0x12,
	0x78, 0x56, 0x34, 0x12, 0x78, 0x56, 0x34, 0x12);

u8_t vnd_value[] = { 'V', 'e', 'n', 'd', 'o', 'r' };
static u8_t simulate_vnd;
static u8_t indicating;
static struct bt_gatt_indicate_params ind_params;

static ssize_t read_vnd(struct bt_conn *conn, const struct bt_gatt_attr *attr,
			void *buf, u16_t len, u16_t offset)
{
	const char *value = attr->user_data;

	return bt_gatt_attr_read(conn, attr, buf, len, offset, value,
				 strlen(value));
}

static ssize_t write_vnd(struct bt_conn *conn, const struct bt_gatt_attr *attr,
			 const void *buf, u16_t len, u16_t offset,
			 u8_t flags)
{
	u8_t *value = attr->user_data;

	if (offset + len > sizeof(vnd_value)) {
		return BT_GATT_ERR(BT_ATT_ERR_INVALID_OFFSET);
	}

	memcpy(value + offset, buf, len);

	return len;
}

void indicate_cb(struct bt_conn *conn, const struct bt_gatt_attr *attr,
			u8_t err)
{
	printk("Indication %s\n", err != 0U ? "fail" : "success");
	indicating = 0U;
}

u8_t vnd_long_value[] = {
		  'V', 'e', 'n', 'd', 'o', 'r', ' ', 'd', 'a', 't', 'a', '1',
		  'V', 'e', 'n', 'd', 'o', 'r', ' ', 'd', 'a', 't', 'a', '2',
		  'V', 'e', 'n', 'd', 'o', 'r', ' ', 'd', 'a', 't', 'a', '3',
		  'V', 'e', 'n', 'd', 'o', 'r', ' ', 'd', 'a', 't', 'a', '4',
		  'V', 'e', 'n', 'd', 'o', 'r', ' ', 'd', 'a', 't', 'a', '5',
		  'V', 'e', 'n', 'd', 'o', 'r', ' ', 'd', 'a', 't', 'a', '6',
		  '.', ' ' };

static ssize_t read_long_vnd(struct bt_conn *conn,
			     const struct bt_gatt_attr *attr, void *buf,
			     u16_t len, u16_t offset)
{
	const char *value = attr->user_data;

	return bt_gatt_attr_read(conn, attr, buf, len, offset, value,
				 sizeof(vnd_long_value));
}

static ssize_t write_long_vnd(struct bt_conn *conn,
			      const struct bt_gatt_attr *attr, const void *buf,
			      u16_t len, u16_t offset, u8_t flags)
{
	u8_t *value = attr->user_data;

	if (flags & BT_GATT_WRITE_FLAG_PREPARE) {
		return 0;
	}

	if (offset + len > sizeof(vnd_long_value)) {
		return BT_GATT_ERR(BT_ATT_ERR_INVALID_OFFSET);
	}

	memcpy(value + offset, buf, len);

	return len;
}

const struct bt_uuid_128 vnd_long_uuid = BT_UUID_INIT_128(
	0xf3, 0xde, 0xbc, 0x9a, 0x78, 0x56, 0x34, 0x12,
	0x78, 0x56, 0x34, 0x12, 0x78, 0x56, 0x34, 0x12);

static struct bt_gatt_cep vnd_long_cep = {
	.properties = BT_GATT_CEP_RELIABLE_WRITE,
};

static int signed_value;

static ssize_t read_signed(struct bt_conn *conn, const struct bt_gatt_attr *attr,
			   void *buf, u16_t len, u16_t offset)
{
	const char *value = attr->user_data;

	return bt_gatt_attr_read(conn, attr, buf, len, offset, value,
				 sizeof(signed_value));
}

static ssize_t write_signed(struct bt_conn *conn, const struct bt_gatt_attr *attr,
			    const void *buf, u16_t len, u16_t offset,
			    u8_t flags)
{
	u8_t *value = attr->user_data;

	if (offset + len > sizeof(signed_value)) {
		return BT_GATT_ERR(BT_ATT_ERR_INVALID_OFFSET);
	}

	memcpy(value + offset, buf, len);

	return len;
}

const struct bt_uuid_128 vnd_signed_uuid = BT_UUID_INIT_128(
	0xf3, 0xde, 0xbc, 0x9a, 0x78, 0x56, 0x34, 0x13,
	0x78, 0x56, 0x34, 0x12, 0x78, 0x56, 0x34, 0x13);

const struct bt_uuid_128 vnd_write_cmd_uuid = BT_UUID_INIT_128(
	0xf4, 0xde, 0xbc, 0x9a, 0x78, 0x56, 0x34, 0x12,
	0x78, 0x56, 0x34, 0x12, 0x78, 0x56, 0x34, 0x12);

static ssize_t write_without_rsp_vnd(struct bt_conn *conn,
				     struct bt_gatt_attr *attr,
				     void *buf, u16_t len, u16_t offset,
				     u8_t flags)
{
	u8_t *value = attr->user_data;

	/* Write request received. Reject it since this char only accepts
	 * Write Commands.
	 */
	if (!(flags & BT_GATT_WRITE_FLAG_CMD)) {
		return BT_GATT_ERR(BT_ATT_ERR_WRITE_REQ_REJECTED);
	}

	if (offset + len > sizeof(vnd_value)) {
		return BT_GATT_ERR(BT_ATT_ERR_INVALID_OFFSET);
	}

	memcpy(value + offset, buf, len);

	return len;
}
static void vnd_ccc_cfg_changed(const struct bt_gatt_attr *attr, u16_t value)
{
	simulate_vnd = ((value == BT_GATT_CCC_INDICATE) ? 1 : 0);
}
// Vendor Primary Service Declaration 
BT_GATT_SERVICE_DEFINE(vnd_svc,
	BT_GATT_PRIMARY_SERVICE(&vnd_uuid),
	BT_GATT_CHARACTERISTIC(&vnd_enc_uuid.uuid,
			       BT_GATT_CHRC_READ | BT_GATT_CHRC_WRITE |
			       BT_GATT_CHRC_INDICATE,
			       BT_GATT_PERM_READ_ENCRYPT |
			       BT_GATT_PERM_WRITE_ENCRYPT,
			       read_vnd, write_vnd, vnd_value),
	BT_GATT_CCC(vnd_ccc_cfg_changed),
	BT_GATT_CHARACTERISTIC(&vnd_auth_uuid.uuid,
			       BT_GATT_CHRC_READ | BT_GATT_CHRC_WRITE,
			       BT_GATT_PERM_READ_AUTHEN |
			       BT_GATT_PERM_WRITE_AUTHEN,
			       read_vnd, write_vnd, vnd_value),
	BT_GATT_CHARACTERISTIC(&vnd_long_uuid.uuid, BT_GATT_CHRC_READ |
			       BT_GATT_CHRC_WRITE | BT_GATT_CHRC_EXT_PROP,
			       BT_GATT_PERM_READ | BT_GATT_PERM_WRITE |
			       BT_GATT_PERM_PREPARE_WRITE,
			       read_long_vnd, write_long_vnd, &vnd_long_value),
	BT_GATT_CEP(&vnd_long_cep),
	BT_GATT_CHARACTERISTIC(&vnd_signed_uuid.uuid, BT_GATT_CHRC_READ |
			       BT_GATT_CHRC_WRITE | BT_GATT_CHRC_AUTH,
			       BT_GATT_PERM_READ | BT_GATT_PERM_WRITE,
			       read_signed, write_signed, &signed_value),
	BT_GATT_CHARACTERISTIC(&vnd_write_cmd_uuid.uuid,
			       BT_GATT_CHRC_WRITE_WITHOUT_RESP,
			       BT_GATT_PERM_WRITE, NULL,
			       write_without_rsp_vnd, &vnd_value),
);

static const struct bt_data ad[] = {
	BT_DATA_BYTES(BT_DATA_FLAGS, (BT_LE_AD_GENERAL | BT_LE_AD_NO_BREDR)),
	BT_DATA_BYTES(BT_DATA_UUID16_ALL,
		      0x0d, 0x18, 0x0f, 0x18, 0x05, 0x18),
	BT_DATA_BYTES(BT_DATA_UUID128_ALL,
		      0xf0, 0xde, 0xbc, 0x9a, 0x78, 0x56, 0x34, 0x12,
		      0x78, 0x56, 0x34, 0x12, 0x78, 0x56, 0x34, 0x12),
};

static void connected(struct bt_conn *conn, u8_t err)
{
	if (err) {
		printk("Connection failed (err 0x%02x)\n", err);
	} else {
		printk("Connected\n");
               // indicate_cb(conn, &vnd_svc, err);
	}
}

static void disconnected(struct bt_conn *conn, u8_t reason)
{
	printk("Disconnected (reason 0x%02x)\n", reason);
}

static struct bt_conn_cb conn_callbacks = {
	.connected = connected,
	.disconnected = disconnected,
};

static void bt_ready(int err)
{
	if (err) {
		printk("Bluetooth init failed (err %d)\n", err);
		return;
	}

	printk("Bluetooth initialized\n");

	cts_init();

	if (IS_ENABLED(CONFIG_SETTINGS)) {
		settings_load();
	}

	err = bt_le_adv_start(BT_LE_ADV_CONN_NAME, ad, ARRAY_SIZE(ad), NULL, 0);
	if (err) {
		printk("Advertising failed to start (err %d)\n", err);
		return;
	}

	printk("Advertising successfully started\n");
}

static void auth_passkey_display(struct bt_conn *conn, unsigned int passkey)
{
	char addr[BT_ADDR_LE_STR_LEN];

	bt_addr_le_to_str(bt_conn_get_dst(conn), addr, sizeof(addr));

	printk("Passkey for %s: %06u\n", addr, passkey);
}

static void auth_cancel(struct bt_conn *conn)
{
	char addr[BT_ADDR_LE_STR_LEN];

	bt_addr_le_to_str(bt_conn_get_dst(conn), addr, sizeof(addr));

	printk("Pairing cancelled: %s\n", addr);
}

static struct bt_conn_auth_cb auth_cb_display = {
	.passkey_display = auth_passkey_display,
	.passkey_entry = NULL,
	.cancel = auth_cancel,
};

void main(void)
{
    static K_FIFO_DEFINE(rx_queue);
    struct net_buf *buf;
    k_tid_t tx_id;
    int err;

	err = bt_enable(bt_ready);
	if (err) {
		printk("Bluetooth init failed (err %d)\n", err);
		return;
	}
	
	
	bt_conn_cb_register(&conn_callbacks);
	bt_conn_auth_cb_register(&auth_cb_display);

	
        
	printk("Start");

/*
	err = bt_enable_raw(&rx_queue);
	if (err) {
		LOG_ERR("bt_enable_raw: %d; aborting", err);
		return;
	}
*/
	/* Spawn the TX thread, which feeds cmds and data to the controller */
        /*
	tx_id = k_thread_create(&bt_tx_thread_data, bt_tx_thread_stack,
				K_THREAD_STACK_SIZEOF(bt_tx_thread_stack),
				bt_tx_thread, NULL, NULL, NULL, K_PRIO_COOP(7),
				0, K_NO_WAIT);
*/
	/* Implement notification. At the moment there is no suitable way
	 * of starting delayed work so we do it here
	 */
	while (1) {
		k_sleep(MSEC_PER_SEC);

		/* Current Time Service updates only when time is changed */
		cts_notify();
               
                buf = net_buf_get(&rx_queue, K_FOREVER);
                if(ready_to_process_flag == 1)
                {
                  ready_to_process_flag = 0;
                  data_handler_rx(buf->data,buf->len);
                }
		
		if (simulate_vnd) {
			if (indicating) {
				continue;
			}

                   ind_params.attr = &vnd_svc.attrs[2];
	           ind_params.func = indicate_cb;
	           ind_params.data = &indicating;
	           ind_params.len = sizeof(indicating);

	           if (bt_gatt_indicate(NULL, &ind_params) == 0) {
				indicating = 1U;
	           }
               }
	}
}
```

## src/ReceiveProcessData.c
```c
#include <stdlib.h> 
#include <stddef.h>
#include <string.h>
#include <time.h> 
#include <sys/byteorder.h>
#include <sys/printk.h>

//#include "peer_manager.h"  
#include "data_protocol.h"
//#include "nrf_crypto.h"
//#include "nrf_crypto_error.h"

#define  MAX_DATA_PROTOCOL_MESSAGE_SIZE    200
#define  LITTLE_ENDIAN                     true //We assuming that this software is running on ARM processor 
//#define  SCM_DEVICE                        true
#define  BSM_DEVICE                        true
#define  DATA_BUS_WIDENESS                 32
//#define AES_ENCODING                      true
//#define PEER_MANAGEMENT_ENABLE              true   
//----------------------------------------------------------------------------------------------------------
void encrypt_cbc(void);
void decrypt_cbc(void);
void convert_big_endian_to_little_endian_and_back(unsigned char *src, unsigned char *dest, short int length);
void process_message(void);
long int calculateCRC32(void);
long int calculateCRC32resp(void);
void SetTimeInside(MessageTimestamp *timestamp);
MessageTimestamp *GetInsideTimeinTimestamp(void);
uint8_t GetTimeInsideAwake(void);
void OutReportStatus(void);
void OutRunDiagnostics(void);
void OutSetTime(void);
void OutConfirmARM(void);
void OutEventLogMessage(void);
void OutRejectARM(void);
void OutPairing(int status);
void OutUnPairing(void);
void OutDISARM(void);
void OutEraseEventLog(void);
void OutConfigureSensor(void);
void OutEventLog(void);
void SolicitedMessage(void);
void AcknoweledgementMessage(int status);
void OutEventLogMessage(void);
//----------------------------------------------------------------------------------------------------------

//------------incoming and outcoming messages spaces--------------------------------------------------------
static unsigned char incoming_message[MAX_DATA_PROTOCOL_MESSAGE_SIZE];
static int incoming_message_length;
static unsigned char outcoming_message[MAX_DATA_PROTOCOL_MESSAGE_SIZE];
static int outcoming_message_length;
static unsigned char local_message_in[MAX_DATA_PROTOCOL_MESSAGE_SIZE];
static int local_message_in_length;
static unsigned char local_message_out[MAX_DATA_PROTOCOL_MESSAGE_SIZE];
static int local_message_out_length;
static unsigned char local_message_in_decr[MAX_DATA_PROTOCOL_MESSAGE_SIZE];
static int local_message_in_decr_length;
static unsigned char local_message_out_decr[MAX_DATA_PROTOCOL_MESSAGE_SIZE];
static int local_message_out_decr_length;

//----------------------------------------------------------------------------------------------------------
int ready_to_process_flag = 0;
int ready_to_send_flag = 0;
static int armed = 0;
static int paired = 0;
static int time_set = 0;
static long int ascension_number = 0;
static MessageTimestamp startTime;
#ifdef AES_ENCODING
/* Maximum allowed key = 256 bit */
static uint8_t m_key[32] = {'N', 'O', 'R', 'D', 'I', 'C', ' ',
                            'S', 'E', 'M', 'I', 'C', 'O', 'N', 'D', 'U', 'C', 'T', 'O', 'R',
                            'A', 'E', 'S', ' ', 'C', 'B', 'C', ' ', 'T', 'E', 'S', 'T'};
#endif
void data_to_send(u8_t *data,u16_t *len)
{
   memcpy(data, &outcoming_message[0],outcoming_message_length);
   *len = outcoming_message_length;
}
void data_handler_rx(u8_t *data,u16_t len)
{

        printk("BSM received message %d bytes", len);
        ready_to_process_flag = 1;
        ready_to_send_flag = 0;

	if(len > MAX_DATA_PROTOCOL_MESSAGE_SIZE)
        {
           printk("Incoming message too long");
 	}			
	memcpy(&incoming_message[0],data,len);
	incoming_message_length = len;
#ifdef SCM_DEVICE
        //In case of SCM we just transfer data to BSM
        outcoming_message_length = incoming_message_length; 
        memcpy(&outcoming_message[0],&incoming_message[0],outcoming_message_length);
#else
#ifdef BSM_DEVICE
        process_message();
	encrypt_cbc();
#endif

#ifdef LITTLE_ENDIAN
        convert_big_endian_to_little_endian_and_back(&local_message_out[0],&outcoming_message[0],local_message_out_length);
#else
	    memcpy(&outcoming_message[0],&local_message_out[0],local_message_out_length);
#endif
        
	outcoming_message_length = local_message_out_length;
#endif  
	printk("Transmitting response of command to central.\n");
        ready_to_process_flag = 0;
        ready_to_send_flag = 1;
}
void process_message(void)
{
	   long int calculated_crc = 0;
	   MSGPayload *payload = (MSGPayload *)&local_message_in_decr[sizeof(SMessageHeader)];
	   MsgIntegrity *checksum_in = (MsgIntegrity *)&local_message_in_decr[sizeof(SMessageHeader)];
#ifdef PEER_MANAGEMENT_ENABLE
	   SMessageHeader *hdr = (SMessageHeader *)&local_message_out_decr[0];
	   pm_peer_id_t *p_peers;
	   ble_gap_addr_t * p_addrs;
	   uint32_t p_size;
	   int count;
#endif
	   
#ifdef LITTLE_ENDIAN
        convert_big_endian_to_little_endian_and_back(&incoming_message[0],&local_message_in[0],incoming_message_length);
#else
        memcpy(&local_message[0],&incoming_message[0],incoming_message_length);
#endif
        local_message_in_length = incoming_message_length;
		decrypt_cbc();
		//Processing successfully received message
		switch(payload->data[0])//Always correspond to OP_Code
		{
			case ReportStatus: 
			     checksum_in += sizeof(ReportStatusPayload);
			     ascension_number++;
			     OutReportStatus();
				break;
			case RunDiagnostics:
			     checksum_in += sizeof(RunDiagnosticsPayload);
			     OutRunDiagnostics();
			    break;
	        case SetTime:
			     time_set = 1;
				 checksum_in += sizeof(SetTimePayload);
				 SetTimeInside((MessageTimestamp *)&payload + sizeof(MessageTimestamp));
			     OutSetTime();
				break;
	        case ARM:
			     checksum_in += sizeof(ARMPayload);
			     if(armed == 1)
				 {
					 OutRejectARM();
				 }
				 else
				 {
					 armed = 1;
					 OutConfirmARM();
				 }
			    break;
	        case PairCommand:
			     checksum_in += sizeof(PairCommandPayload);
#ifdef PEER_MANAGEMENT_ENABLE
			     if( pm_peer_count() >= BLE_GAP_WHITELIST_ADDR_MAX_COUNT) {
				   OutPairing(1);
				 }
                            else {			   
					if(pm_id_addr_set((ble_gap_addr_t const *)&hdr->sa.sa_data[0]) == NRF_SUCCESS)
					{
#endif
						paired = 1;
						OutPairing(0);
#ifdef PEER_MANAGEMENT_ENABLE
					}
					else
					{
						OutPairing(1);
					}
				 }
#endif
			    break;
	        case UnPairCommand:
			     checksum_in += sizeof(UnPairCommandPayload);
#ifdef PEER_MANAGEMENT_ENABLE
			     p_size = pm_peer_count();
			     p_peers = calloc(sizeof(pm_peer_id_t),BLE_GAP_WHITELIST_ADDR_MAX_COUNT);
			     pm_peer_id_list(p_peers, &p_size,(pm_peer_id_t)1,(pm_peer_id_t)0);
			     for(count = 0; count < BLE_GAP_WHITELIST_ADDR_MAX_COUNT; count++)
			     {   //Removing peer corresponding MAC address
			         p_addrs = NULL;
			         if(pm_id_addr_get(p_addrs) == NRF_SUCCESS)
				 {
				    pm_whitelist_get(p_addrs,
                                            &p_size,
                                            NULL,
		                            NULL);
		         	    if(memcmp(p_addrs,&(hdr->sa.sa_data[0]),sizeof(SourceAddress)) == 0)
		    		    {
					pm_peer_delete(*p_peers);
					break;
		         	    }
				 }
		        	 p_peers++;
			     }
#endif
			     paired = 0;
			     OutUnPairing();
			    break;
	        case DISARM:
			     checksum_in += sizeof(DISARMPayload);
			     armed = 0;
				 OutDISARM();
			    break;
	        case SendAllEventLog:
			     checksum_in += sizeof(SendAllEventLogPayload);
			     ascension_number++;
			     OutEventLog();
			    break;
	        case EraseEventLog:
			     checksum_in += sizeof(EraseEventLogPayload);
			     OutEraseEventLog();
			    break;
	        case ConfigureSensor:
			     checksum_in += sizeof(ConfigureSensorPayload);
			     OutConfigureSensor();
			    break;
			default:
                          printk("Bad or unimplemented operation\n");
			  break;
		}
		calculated_crc = calculateCRC32();
		if(calculated_crc != checksum_in->m_d)
		{
	           //We just ignore it because BLE has own CRC check
		   printk("CRC sum is BAD\n");
		}
}
void OutReportStatus(void)
{
	SolicitedMessage();
}
void OutRunDiagnostics(void)
{
	SolicitedMessage();
}
void OutSetTime(void)
{
	AcknoweledgementMessage(0);
}
void OutConfirmARM(void)
{
	AcknoweledgementMessage(0);
}
void OutRejectARM(void)
{
	AcknoweledgementMessage(1);
}
void OutPairing(int status)
{
	AcknoweledgementMessage(status);
}
void OutUnPairing(void)
{
	AcknoweledgementMessage(0);
}
void OutDISARM(void)
{
	AcknoweledgementMessage(0);
}
void OutEraseEventLog(void)
{
	AcknoweledgementMessage(0);
}
void OutConfigureSensor(void)
{
	AcknoweledgementMessage(0);
}
void OutEventLog(void)
{
	OutEventLogMessage();
}
void SolicitedMessage(void)
{
  MsgSolicitedPaylodResponse *response_ptr = (MsgSolicitedPaylodResponse *)&local_message_out_decr[sizeof(SMessageHeader)];
  SMessageHeader *response_hdr_ptr = (SMessageHeader *)&local_message_out_decr[0];
  SMessageHeader *request_hdr_ptr = (SMessageHeader *)&local_message_in_decr[0];
  MsgIntegrity_d *crc_ptr = (MsgIntegrity_d *)&local_message_out_decr[sizeof(SMessageHeader) + sizeof(Status_Summary)];
  uint32_t checksum;
  
  
     response_ptr->ss.ssb.Diag_Status = 1;
  
     response_ptr->ss.ssb.Pwr_Status = 1;
  
  if(paired == 1)
    response_ptr->ss.ssb.Pairing_Status = 0;
  else
    response_ptr->ss.ssb.Pairing_Status = 1;

  if(armed == 1)
	response_ptr->ss.ssb.Arming_Status = 0;
  else
	response_ptr->ss.ssb.Arming_Status = 1; 

  if(time_set == 1)
	response_ptr->ss.ssb.Time_Set_Status = 0;
  else
	response_ptr->ss.ssb.Time_Set_Status = 1;  

  //response_ptr->ss.as; TBD

  response_ptr->ss.at.at_d = GetTimeInsideAwake();
  
  //response_ptr->ss.rc TBD
  
  response_ptr->ss.aa.aa_d = (uint16_t)ascension_number;
  
  response_hdr_ptr->st = BSM;
  response_hdr_ptr->mt = SolictedStatusMessage;
  response_hdr_ptr->ml = sizeof(Status_Summary) + sizeof(MsgIntegrity);
  memcpy(&response_hdr_ptr->sa.sa_data[0],&request_hdr_ptr->da.da_data[0],sizeof(SourceAddress));
  memcpy(&response_hdr_ptr->da.da_data[0],&request_hdr_ptr->sa.sa_data[0],sizeof(SourceAddress));
  response_hdr_ptr->icd_rev = request_hdr_ptr->icd_rev;
  response_hdr_ptr->msga = request_hdr_ptr->msga;
  response_hdr_ptr->rp = request_hdr_ptr->rp;
  
  checksum = calculateCRC32resp();
  memcpy(crc_ptr,&checksum,sizeof(MsgIntegrity));
  local_message_out_decr_length = sizeof(SMessageHeader) + sizeof(Status_Summary) + sizeof(MsgIntegrity);
}
void AcknoweledgementMessage(int status)
{
  ACK *response_ptr = (ACK *)&local_message_out_decr[sizeof(SMessageHeader)];
  SMessageHeader *response_hdr_ptr = (SMessageHeader *)&local_message_out_decr[0];
  SMessageHeader *request_hdr_ptr = (SMessageHeader *)&local_message_in_decr[0];
  MsgIntegrity_d *crc_ptr = (MsgIntegrity_d *)&local_message_out_decr[sizeof(SMessageHeader) + sizeof(ACK)];
  uint32_t checksum;
  
  response_ptr->a_d.aa = (uint16_t)ascension_number;
  response_ptr->a_d.aw = status;
  
  response_hdr_ptr->st = BSM;
  response_hdr_ptr->mt = ACKMessage;
  response_hdr_ptr->ml = sizeof(ACK) + sizeof(MsgIntegrity);
  memcpy(&response_hdr_ptr->sa.sa_data[0],&request_hdr_ptr->da.da_data[0],sizeof(SourceAddress));
  memcpy(&response_hdr_ptr->da.da_data[0],&request_hdr_ptr->sa.sa_data[0],sizeof(SourceAddress));
  response_hdr_ptr->icd_rev = request_hdr_ptr->icd_rev;
  response_hdr_ptr->msga = request_hdr_ptr->msga;
  response_hdr_ptr->rp = request_hdr_ptr->rp;
  
  checksum = calculateCRC32resp();
  memcpy(crc_ptr,&checksum,sizeof(MsgIntegrity));
  local_message_out_decr_length = sizeof(SMessageHeader) + sizeof(ACK) + sizeof(MsgIntegrity);
}
void OutEventLogMessage(void)
{
  MsgPayloadEventLogResponse *response_ptr = (MsgPayloadEventLogResponse *)&local_message_out_decr[sizeof(SMessageHeader)];
  SMessageHeader *response_hdr_ptr = (SMessageHeader *)&local_message_out_decr[0];
  SMessageHeader *request_hdr_ptr = (SMessageHeader *)&local_message_in_decr[0];
  MsgIntegrity_d *crc_ptr = (MsgIntegrity_d *)&local_message_out_decr[sizeof(SMessageHeader) + sizeof(MsgPayloadEventLogResponse)];
  uint32_t checksum;
  
  response_ptr->aelr = (uint16_t)ascension_number;
  //response_ptr->etp  TBD
  memcpy(&response_ptr->et.et_d,GetInsideTimeinTimestamp(),sizeof(MessageTimestamp));
  response_ptr->lrr = (uint8_t)100;
  
  response_hdr_ptr->st = BSM;
  response_hdr_ptr->mt = DeviceEventLogRecord;
  response_hdr_ptr->ml = sizeof(MsgPayloadEventLogResponse) + sizeof(MsgIntegrity);
  memcpy(&response_hdr_ptr->sa.sa_data[0],&request_hdr_ptr->da.da_data[0],sizeof(SourceAddress));
  memcpy(&response_hdr_ptr->da.da_data[0],&request_hdr_ptr->sa.sa_data[0],sizeof(SourceAddress));
  response_hdr_ptr->icd_rev = request_hdr_ptr->icd_rev;
  response_hdr_ptr->msga = request_hdr_ptr->msga;
  response_hdr_ptr->rp = request_hdr_ptr->rp;
  
  checksum = calculateCRC32resp();
  memcpy(crc_ptr,&checksum,sizeof(MsgIntegrity));
  local_message_out_decr_length = sizeof(SMessageHeader) + sizeof(MsgPayloadEventLogResponse) + sizeof(MsgIntegrity);

}
//Service routines------------------------------------------------------------------------------------------------------
void SetTimeInside(MessageTimestamp *timestamp)
{
    time_t time;
    u16_t year;

	/* 'Exact Time 256' contains 'Day Date Time' which contains
	 * 'Date Time' - characteristic contains fields for:
	 * year, month, day, hours, minutes and seconds.
	 */

	year = sys_cpu_to_le16(timestamp->m_d.year + 30);//Linux start epox 1970, AKUA start epox 2000
        time = year;
        time *= 3600*30*24*12;
	time += 3600*30*24*timestamp->m_d.month; /* months starting from 1 */
	time += 3600*24*timestamp->m_d.day; /* day */
        time += 3600*timestamp->m_d.hour; /* hours */
	time += 60*timestamp->m_d.minute; /* minutes */
	time += timestamp->m_d.seconds; /* seconds */
        gmtime(time);
}
uint8_t GetTimeInsideAwake(void)
{
	struct tm  ts_start,ts_now;
	uint8_t time_diff;
	memcpy(&ts_now,gmtime(0), sizeof(struct tm));
	
        time_diff= sys_get_le32(startTime.m_d.year) - sys_get_le32(ts_now.tm_year);
        time_diff += startTime.m_d.month - ts_now.tm_mon;
        time_diff += startTime.m_d.day - ts_now.tm_mday;
	
	return time_diff;
}

MessageTimestamp *GetInsideTimeinTimestamp(void)
{
	struct tm ts;
	static MessageTimestamp currTime;	
	
	memcpy(&ts,gmtime(0),sizeof(struct tm));
	
	currTime.m_d.seconds = ts.tm_sec;
    currTime.m_d.minute = ts.tm_min;
    currTime.m_d.hour = ts.tm_hour;
    currTime.m_d.day = ts.tm_mday;
    currTime.m_d.month = ts.tm_mon;
	currTime.m_d.year = ts.tm_year - 30 ; //Linux start epox 1970, AKUA 2000
	
	return &currTime; 
}

void convert_big_endian_to_little_endian_and_back(unsigned char *src, unsigned char *dest, short int length)
{
	short int chunks, index, piece;
	
	chunks = (int)(length/DATA_BUS_WIDENESS - 0.5);
	chunks++;
	for(piece = 0; piece < chunks; piece++) {
	    for(index = 0; index < DATA_BUS_WIDENESS; index++) {
	        *dest++ = *(src + DATA_BUS_WIDENESS - 1 - index)  ;
		}
	    dest += DATA_BUS_WIDENESS;
		src  += DATA_BUS_WIDENESS;
	}
}

void encrypt_cbc(void)
{
#ifdef AES_ENCODING	
	uint8_t     iv[16];
    ret_code_t  ret_val;

	static nrf_crypto_aes_context_t cbc_encr_128_ctx; // AES CBC encryption context
	
	NRF_LOG_RAW_INFO("Decripted outgoing message.");
    NRF_LOG_HEXDUMP_DEBUG(&local_message_out_decr[0],local_message_out_decr_length);
	
	/* Init encryption context for 128 bit key and PKCS7 padding mode */
    ret_val = nrf_crypto_aes_init(&cbc_encr_128_ctx,
                                  &g_nrf_crypto_aes_cbc_128_pad_pkcs7_info,
                                  NRF_CRYPTO_ENCRYPT);
    APP_ERROR_CHECK(ret_val);

    /* Set key for encryption context - only first 128 key bits will be used */
    ret_val = nrf_crypto_aes_key_set(&cbc_encr_128_ctx, m_key);
    APP_ERROR_CHECK(ret_val);

    memset(iv, 0, sizeof(iv));
    /* Set IV for encryption context */

    ret_val = nrf_crypto_aes_iv_set(&cbc_encr_128_ctx, iv);
    APP_ERROR_CHECK(ret_val);

    // Header of the message decripted all the time
    memcpy(&local_message_out[0],&local_message_out_decr[0],sizeof(SMessageHeader));


    ret_val = nrf_crypto_aes_finalize(&cbc_encr_128_ctx,
                                      (uint8_t *)&local_message_out_decr[sizeof(SMessageHeader)],
                                      local_message_out_decr_length - sizeof(SMessageHeader),
                                      (uint8_t *)&local_message_out[sizeof(SMessageHeader)],
                                      (unsigned int *)&local_message_out_length);
    APP_ERROR_CHECK(ret_val);
	
	local_message_out_length += sizeof(SMessageHeader);
	
	NRF_LOG_RAW_INFO("Encripted outgoing message.");
    NRF_LOG_HEXDUMP_DEBUG(&local_message_out[0],local_message_out_length);
#else
	memcpy(&local_message_out[0],&local_message_out_decr[0],local_message_out_decr_length);
    local_message_out_length = local_message_out_decr_length;
#endif
}

void decrypt_cbc(void)
{
#ifdef AES_ENCODING
	uint8_t     iv[16];
    ret_code_t  ret_val;

    static nrf_crypto_aes_context_t cbc_decr_128_ctx; // AES CBC decryption context

    NRF_LOG_RAW_INFO("Encripted incoming message.");
    NRF_LOG_HEXDUMP_DEBUG(&local_message_in[0],local_message_in_length);
	
	/* Init decryption context for 128 bit key and PKCS7 padding mode */
    ret_val = nrf_crypto_aes_init(&cbc_decr_128_ctx,
                                  &g_nrf_crypto_aes_cbc_128_pad_pkcs7_info,
                                  NRF_CRYPTO_DECRYPT);
    APP_ERROR_CHECK(ret_val);


    /* Set key for decryption context - only first 128 key bits will be used */
    ret_val = nrf_crypto_aes_key_set(&cbc_decr_128_ctx, m_key);
    APP_ERROR_CHECK(ret_val);

    memset(iv, 0, sizeof(iv));
    /* Set IV for decryption context */

    ret_val = nrf_crypto_aes_iv_set(&cbc_decr_128_ctx, iv);
    APP_ERROR_CHECK(ret_val);
	
    // Header of the message decripted all the time
    memcpy(&local_message_in_decr[0],&local_message_in[0],sizeof(SMessageHeader));

    /* Decrypt text */
    ret_val = nrf_crypto_aes_finalize(&cbc_decr_128_ctx,
                                      (uint8_t *)&local_message_in[sizeof(SMessageHeader)],
                                      local_message_in_length - sizeof(SMessageHeader),
                                      (uint8_t *)&local_message_in_decr[sizeof(SMessageHeader)],
                                      (unsigned int *)&local_message_in_decr_length);
    APP_ERROR_CHECK(ret_val);

    /* trim padding */
    local_message_in_decr[local_message_in_decr_length + sizeof(SMessageHeader)] = '\0';
	
	local_message_in_decr_length += sizeof(SMessageHeader);
	
    NRF_LOG_RAW_INFO("Decripted incoming message.\n");
    NRF_LOG_HEXDUMP_DEBUG(&local_message_in_decr[0],local_message_in_decr_length);
#else
	memcpy(&local_message_in_decr[0],&local_message_in[0],local_message_in_length);
    local_message_in_decr_length = local_message_in_length;
#endif
}

long int calculateCRC32(void)
{
    	const uint8_t *p = &local_message_in_decr[0];
		SMessageHeader *ps = (SMessageHeader *)&local_message_in_decr[0]; 
		uint32_t size = (uint32_t)sizeof(SMessageHeader) + (uint32_t)ps->ml - (uint32_t)sizeof(MsgIntegrity); 
 		uint32_t crc;
 
 		crc = ~0U;
 		while (size--)
 			crc = ((crc ^ *p++) & 0xFF) ^ (crc >> 8);
 		return (long int)(crc ^ ~0U);
}

long int calculateCRC32resp(void)
{
    	const uint8_t *p = &local_message_out_decr[0];
		SMessageHeader *ps = (SMessageHeader *)&local_message_in_decr[0];
		uint32_t size = (uint32_t)sizeof(SMessageHeader) + (uint32_t)ps->ml - (uint32_t)sizeof(MsgIntegrity); 
 		uint32_t crc;
 
 		crc = ~0U;
 		while (size--)
 			crc = ((crc ^ *p++) & 0xFF) ^ (crc >> 8);
 		return (long int)(crc ^ ~0U);
}
```

## src/cts.c
```c
/** @file
 *  @brief CTS Service sample
 */

/*
 * Copyright (c) 2016 Intel Corporation
 *
 * SPDX-License-Identifier: Apache-2.0
 */

#include <zephyr/types.h>
#include <stddef.h>
#include <string.h>
#include <errno.h>
#include <sys/printk.h>
#include <sys/byteorder.h>
#include <zephyr.h>
#include <time.h>

#include <bluetooth/bluetooth.h>
#include <bluetooth/hci.h>
#include <bluetooth/conn.h>
#include <bluetooth/uuid.h>
#include <bluetooth/gatt.h>

static u8_t ct[10];
static u8_t ct_update;

static void ct_ccc_cfg_changed(const struct bt_gatt_attr *attr, u16_t value)
{
	/* TODO: Handle value */
}

static ssize_t read_ct(struct bt_conn *conn, const struct bt_gatt_attr *attr,
		       void *buf, u16_t len, u16_t offset)
{
	const char *value = attr->user_data;

	return bt_gatt_attr_read(conn, attr, buf, len, offset, value,
				 sizeof(ct));
}

static ssize_t write_ct(struct bt_conn *conn, const struct bt_gatt_attr *attr,
			const void *buf, u16_t len, u16_t offset,
			u8_t flags)
{
	u8_t *value = attr->user_data;

	if (offset + len > sizeof(ct)) {
		return BT_GATT_ERR(BT_ATT_ERR_INVALID_OFFSET);
	}

	memcpy(value + offset, buf, len);
	ct_update = 1U;

	return len;
}

/* Current Time Service Declaration */
BT_GATT_SERVICE_DEFINE(cts_cvs,
	BT_GATT_PRIMARY_SERVICE(BT_UUID_CTS),
	BT_GATT_CHARACTERISTIC(BT_UUID_CTS_CURRENT_TIME, BT_GATT_CHRC_READ |
			       BT_GATT_CHRC_NOTIFY | BT_GATT_CHRC_WRITE,
			       BT_GATT_PERM_READ | BT_GATT_PERM_WRITE,
			       read_ct, write_ct, ct),
	BT_GATT_CCC(ct_ccc_cfg_changed),
);

static void generate_current_time(u8_t *buf)
{
        struct tm *ts;
	u16_t year;

	/* 'Exact Time 256' contains 'Day Date Time' which contains
	 * 'Date Time' - characteristic contains fields for:
	 * year, month, day, hours, minutes and seconds.
	 */
        ts = gmtime(0);
	year = sys_cpu_to_le16(ts->tm_year);
	memcpy(buf,  &year, 2); /* year */
	buf[2] = ts->tm_mon; /* months starting from 1 */
	buf[3] = ts->tm_mday; /* day */
	buf[4] = ts->tm_hour; /* hours */
	buf[5] = ts->tm_min; /* minutes */
	buf[6] = ts->tm_sec; /* seconds */

	/* 'Day of Week' part of 'Day Date Time' */
	buf[7] = ts->tm_wday; /* day of week starting from 1 */

	/* 'Fractions 256 part of 'Exact Time 256' */
	buf[8] = 0U;

	/* Adjust reason */
	buf[9] = 0U; /* No update, change, etc */
}

void cts_init(void)
{
	/* Simulate current time for Current Time Service */
	generate_current_time(ct);
}

void cts_notify(void)
{	/* Current Time Service updates only when time is changed */
/*	if (!ct_update) {
		return;
	}

	ct_update = 0U; */
	bt_gatt_notify(NULL, &cts_cvs.attrs[1], &ct, sizeof(ct));
}
```

## src/data_protocol.h
```c
/*This data protocol reflects "Secure Hybrid Composite Intermodal Container Project"
 * 
 */
#include <zephyr/types.h>
/*SHCIC Message Header*/
typedef unsigned char SourceDeviceType;
typedef unsigned char MSGLength;
typedef unsigned char MSGType;
typedef union {
	unsigned char sa[6];
	unsigned char sa_data[6];  
} SourceAddress;
typedef union {
	unsigned char da[6];
	unsigned char da_data[6];
} DestinationAddress;
typedef unsigned char ICDRev;
typedef union {
	unsigned char msga[4];
	unsigned char msga_data[4];
}  MSGAscension;
typedef unsigned char RoutingPriority;

typedef struct {
	SourceDeviceType st;
	MSGType mt;
	MSGLength ml;
	SourceAddress sa;
	DestinationAddress da;
	ICDRev icd_rev;
	MSGAscension msga;
	RoutingPriority rp;
} SMessageHeader;

/*3.6.1.2 Message Device Type Codes*/ 
typedef enum {
	BSM=0x80,
	SensorController=0x81,
	C2Server=0x88,
	KeyMgmtServer=0x89
} DeviceType;

/*3.6.1.3 Message Type Codes*/
typedef enum {
	SolictedStatusMessage=0x80,
	DeviceEventLogRecord=0x81,
	UnsolictedStatusMessage=0x82,
	ACKMessage=0x83,
	SecurityDeviceMaintMessage_0=0x90,
	SecurityDeviceMaintMessage_1=0x91,
	SecurityDeviceMaintMessage_2=0x92,
	SecurityDeviceMaintMessage_3=0x93,
	SecurityDeviceMaintMessage_4=0x94,
	SecurityDeviceMaintMessage_5=0x95,
	SecurityDeviceMaintMessage_6=0x96,
	SecurityDeviceMaintMessage_7=0x97,
	SecurityDeviceMaintMessage_8=0x98,
	SecurityDeviceMaintMessage_9=0x99,
	SecurityDeviceMaintMessage_A=0x9A,
	SecurityDeviceMaintMessage_B=0x9B,
	SecurityDeviceMaintMessage_C=0x9C,
	SecurityDeviceMaintMessage_D=0x9D,
	SecurityDeviceMaintMessage_E=0x9E,
	SecurityDeviceMaintMessage_F=0x9F,
	DeviceCommand=0xC1,
	KeyMgmtRekey_0=0xE0,
	KeyMgmtRekey_1=0xE1,
	KeyMgmtRekey_2=0xE2,
	KeyMgmtRekey_3=0xE3,
	KeyMgmtRekey_4=0xE4,
	KeyMgmtRekey_5=0xE5,
	KeyMgmtRekey_6=0xE6,
	KeyMgmtRekey_7=0xE7,
	KeyMgmtRekey_8=0xE8,
	KeyMgmtRekey_9=0xE9,
} MessageTypeCode;

/* 3.6.2.1 Device Command Message */	
typedef union {
	unsigned char data[25];
	SMessageHeader smh;
} UniversalMSGHeader;
typedef enum {
	ReportStatus=0x1,
	RunDiagnostics=0x2,
	SetTime=0x3,
	ARM=0x4,
	PairCommand=0x5,
	UnPairCommand=0x6,
	DISARM=0x80,
	SendAllEventLog=0xA4,
	EraseEventLog=0xA5,
	ConfigureSensor=0x8
} OP_Code;
typedef unsigned char OP_code_command;
typedef struct {
	unsigned char month;
	unsigned char day;
	uint16_t      year; //Year starting 2000
	unsigned char hour;
	unsigned char minute;
	unsigned char seconds;
	unsigned char hundr_of_seconds;
}   MessageTimestamp_d;
typedef union {
	unsigned char data[8];
	MessageTimestamp_d m_d;
} MessageTimestamp;
typedef unsigned char SynchTime_d[8];
typedef union {
	unsigned char data[8];
	SynchTime_d  s_d;
} SynchTime;
typedef unsigned char SensorToEnable_d[8];
typedef union {
	unsigned char data[8];
	SensorToEnable_d s_d;
} SensorToEnable;
typedef unsigned char unconditional_par;
typedef enum {
	unconditional_yes=0xFF
} unconditional_value;
typedef unsigned char CSD_SD_MAC_d[8];
typedef union {
	unsigned char data[8];
	CSD_SD_MAC_d csd_d;
} CSD_SD_MAC;
typedef unsigned char BSM_Sensor_MAC_d[8];
typedef union {
	unsigned char data[8];
	BSM_Sensor_MAC_d b_d;
} BSM_Sensor_MAC;
typedef unsigned char BSM_Sensor_Type;
typedef unsigned char BSM_Sensor_UID_d[8];
typedef union {
	unsigned char data[8];
	BSM_Sensor_UID_d b_d;
} BSM_Sensor_UID;
typedef unsigned char SensorToDisable_d[8];
typedef union {
	unsigned char data[8];
	SensorToDisable_d s_d;
} SensorToDisable;
typedef unsigned char ConfigurationParam;
typedef uint32_t MsgIntegrity_d;
typedef union {
	unsigned char data[8];
	MsgIntegrity_d  m_d;
} MsgIntegrity;
typedef struct {
	MessageTimestamp mt;
} ReportStatusPayload;
typedef struct {
	MessageTimestamp mt;
} RunDiagnosticsPayload;
typedef struct {
	MessageTimestamp mt;
	SynchTime st;
} SetTimePayload;
typedef struct {
	MessageTimestamp mt;
	SensorToEnable se;
} ARMPayload;
typedef struct {
	MessageTimestamp mt;
	CSD_SD_MAC csd;
	BSM_Sensor_MAC bsmm;
	BSM_Sensor_Type bsmt;
	BSM_Sensor_UID bsmu;
} PairCommandPayload;
typedef struct {
	MessageTimestamp mt;
} UnPairCommandPayload;
typedef struct {
	MessageTimestamp mt; 
	SensorToDisable sd;
} DISARMPayload;
typedef struct {
	MessageTimestamp mt;
} SendAllEventLogPayload;
typedef struct {
	MessageTimestamp mt;
} EraseEventLogPayload;
typedef struct {
	MessageTimestamp mt;
	ConfigurationParam cp;
} ConfigureSensorPayload;
typedef union {
	unsigned char data[94];
	ReportStatusPayload rsp;
	RunDiagnosticsPayload rdp;
	SetTimePayload stp;
	ARMPayload armp;
	PairCommandPayload pcp;
	UnPairCommandPayload upcp;
	DISARMPayload darmp;
	SendAllEventLogPayload sael;
	EraseEventLogPayload eelp;
	ConfigureSensorPayload csp;
} MSGPayload;

typedef struct {
	UniversalMSGHeader umh;
	MSGPayload mp;
	MsgIntegrity mi;
}  DeviceCommandMessage;

typedef struct {
	unsigned Diag_Status : 1;
	unsigned Pwr_Status : 1;
	unsigned Pairing_Status : 1;
	unsigned Arming_Status : 1;
	unsigned Time_Set_Status : 1;
	unsigned unused : 3;
} SolicitedStatusBits;

typedef unsigned char Alarm_Status;

typedef uint8_t Awake_Time_d;

typedef union {
	unsigned char data[2];
	Awake_Time_d at_d;
} Awake_Time;
 
typedef uint16_t Rekey_Counter_d;

typedef union {
	unsigned char data[4];
	Rekey_Counter_d rc_d;
} Rekey_Counter;

typedef uint16_t ACK_Ascension_d;

typedef union {
	unsigned char data[4];
	ACK_Ascension_d aa_d;
} ACK_Ascension;
 
/* 3.6.2.2.1 Solicited Status Message */
typedef struct {
	SolicitedStatusBits ssb;
	Alarm_Status as;
	Awake_Time at;
	Rekey_Counter rc;
	ACK_Ascension aa;
} Status_Summary;

typedef unsigned char Panel_Alarm_Data_d[7];

typedef union {
	unsigned char data[7];
	Panel_Alarm_Data_d pad_d;
} Panel_Alarm_Data;

typedef unsigned char Door_State;

typedef unsigned char Pwr_Level;

typedef unsigned char Reserved1[12];

typedef struct {
	Panel_Alarm_Data pad;
	Door_State ds;
	Pwr_Level pl;
	Reserved1 r1;
} BDS_Status_Details;

typedef struct {
	Reserved1 r1;
} Alarm_Details;

typedef union {
	Status_Summary ss;
	BDS_Status_Details bsd;
	Alarm_Details ad;
	unsigned char data[94];
} MsgSolicitedPaylodResponse;

/* 3.6.2.4.1 Acknoledgement message */
typedef uint16_t ACK_Asc;
typedef unsigned char ACK_WQ;
typedef struct {
	ACK_Asc aa;
	ACK_WQ aw;
} ACK_d;
typedef union {
	unsigned char data[5];
	ACK_d a_d;
} ACK;

/* 3.6.2.5.1 Device Event Log Message*/

typedef unsigned char AscensionEventLogRequest;
typedef unsigned char EventType;
typedef uint32_t EventTime_d;
typedef union {
	unsigned char data[8];
	EventTime_d et_d;
} EventTime;
typedef unsigned char LastRequestRecord;

typedef unsigned char Panel_Alarm_Data_Dflt_d[80];
typedef union {
	unsigned char data[80];
	Panel_Alarm_Data_Dflt_d padd_d;
} Panel_Alarm_Data_Dflt;

typedef struct {
	AscensionEventLogRequest aelr;
	EventType etp;
	EventTime et;
	LastRequestRecord lrr;
	Panel_Alarm_Data_Dflt padd;
} MsgPayloadEventLogResponse;


typedef union {
	MsgSolicitedPaylodResponse mspr;
	ACK ack;
	MsgPayloadEventLogResponse mpelr;
} MsgPaylodResponse;


void data_to_send(u8_t *data,u16_t *len);
void data_handler_rx(u8_t *data,u16_t len);
```
